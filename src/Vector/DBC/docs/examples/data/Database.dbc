VERSION ""

NS_ :

BS_:

BU_: Node_1
VAL_TABLE_ Value_Table 1 "Description for the value '0x1'" 0 "Description for the value '0x0'" ;

BO_ 1 Standard_Message_1: 8 Node_1
 SG_ Signal_1 : 0|8@1- (1,0) [0|0] ""  Node_1

BO_ 2147483649 Extended_Message_1: 8 Node_1
 SG_ Signal_2 : 0|8@1- (1,0) [0|0] ""  Node_1

EV_ Variable_1: 0 [0|1] "" 0 1 DUMMY_NODE_VECTOR0  Node_1;

CM_ "Comment";
CM_ BU_ Node_1 "Comment";
CM_ EV_ Variable_1 "Comment";
BA_DEF_ EV_  "AttrDef_EnvironmentalVariable" INT 0 1;
BA_DEF_ BU_  "AttrDef_Node" INT 0 1;
BA_DEF_DEF_  "AttrDef_EnvironmentalVariable" 0;
BA_DEF_DEF_  "AttrDef_Node" 0;
BA_ "AttrDef_Node" BU_ Node_1 1;
BA_ "AttrDef_EnvironmentalVariable" EV_ Variable_1 1;
VAL_ Variable_1 1 "Description for the value '0x1'" 0 "Description for the value '0x0'" ;
