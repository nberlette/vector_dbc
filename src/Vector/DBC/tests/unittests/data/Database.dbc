VERSION ""

NS_ :

BS_:

BU_:

BO_ 1 Standard_Message_1: 8 Vector__XXX
 SG_ Signal : 0|8@1- (1,0) [0|0] "" Vector__XXX

BO_ 2147483649 Extended_Message_1: 8 Vector__XXX
 SG_ Signal : 0|8@1- (1,0) [0|0] "" Vector__XXX

BA_DEF_  "BusType" STRING ;
BA_DEF_DEF_  "BusType" "CAN";
